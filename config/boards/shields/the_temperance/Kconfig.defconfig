## config/boards/shields/the_temperance/Kconfig.defconfig
```kconfig
if SHIELD_TEMPERANCE

config ZMK_KEYBOARD_NAME
    default "XIV Temperance"

config ZMK_USB
    default y

endif
```

## config/west.yml
```yaml
manifest:
  remotes:
    - name: zmkfirmware
      url-base: https://github.com/zmkfirmware
    - name: happyrip
      url-base: https://github.com/happyrip
  projects:
    - name: zmk
      remote: happyrip
      revision: zephyr-2.5-upgrade
      import: app/west.yml
  self:
    path: config
```
